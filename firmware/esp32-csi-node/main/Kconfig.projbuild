## firmware/esp32-csi-node/main/Kconfig.projbuild
```kconfig
menu "CSI Node Configuration"

    config CSI_NODE_ID
        int "Node ID (0-255)"
        default 1
        range 0 255
        help
            Unique identifier for this ESP32 CSI node.

    config CSI_TARGET_IP
        string "Aggregator IP address"
        default "192.168.1.100"
        help
            IP address of the UDP aggregator host.

    config CSI_TARGET_PORT
        int "Aggregator UDP port"
        default 5005
        range 1024 65535
        help
            UDP port the aggregator listens on.

    config CSI_WIFI_SSID
        string "WiFi SSID"
        default "wifi-densepose"
        help
            SSID of the WiFi network to connect to.

    config CSI_WIFI_PASSWORD
        string "WiFi Password"
        default ""
        help
            Password for the WiFi network. Leave empty for open networks.

    config CSI_WIFI_CHANNEL
        int "WiFi Channel (1-13)"
        default 6
        range 1 13
        help
            WiFi channel to listen on for CSI data.

endmenu

menu "Edge Intelligence (ADR-039)"

    config EDGE_TIER
        int "Edge processing tier (0=raw, 1=basic, 2=full)"
        default 2
        range 0 2
        help
            0 = Raw passthrough (no on-device DSP).
            1 = Basic presence/motion detection.
            2 = Full pipeline (vitals, compression, multi-person).

    config EDGE_VITAL_INTERVAL_MS
        int "Vitals packet send interval (ms)"
        default 1000
        range 100 10000
        help
            How often to send vitals packets over UDP.

    config EDGE_TOP_K
        int "Top-K subcarriers to track"
        default 8
        range 1 32
        help
            Number of highest-variance subcarriers to use for DSP.

    config EDGE_FALL_THRESH
        int "Fall detection threshold (x1000)"
        default 15000
        range 100 50000
        help
            Phase acceleration threshold for fall detection.
            Value is divided by 1000 to get rad/s². Default 15000 = 15.0 rad/s².
            Raise to reduce false positives in high-traffic environments.
            Normal walking produces accelerations of 2-5 rad/s².
            Stored as integer; divided by 1000 at runtime.

    config EDGE_POWER_DUTY
        int "Power duty cycle percentage"
        default 100
        range 10 100
        help
            Active duty cycle for battery-powered nodes.
            100 = always on. 50 = active half the time.

endmenu

menu "Piezo Speaker"

    config PIEZO_GPIO
        int "Piezo GPIO (-1 disables speaker output)"
        default -1
        range -1 48
        help
            GPIO used for piezo PWM output. Set to -1 to leave the
            speaker path disabled until an NVS override is provisioned.

    config PIEZO_DEFAULT_FREQ_HZ
        int "Default piezo frequency (Hz)"
        default 2200
        range 100 20000

    config PIEZO_DEFAULT_DURATION_MS
        int "Default piezo tone duration (ms)"
        default 180
        range 10 60000

    config PIEZO_DEFAULT_GAP_MS
        int "Default piezo pattern gap (ms)"
        default 90
        range 10 60000

    config PIEZO_DEFAULT_DUTY_PCT
        int "Default piezo duty cycle (%)"
        default 40
        range 1 90

endmenu

menu "Boot Health & Watchdog"

    config BOOT_STABILITY_DELAY_MS
        int "Stable-boot delay before clearing crash counter (ms)"
        default 30000
        range 5000 600000
        help
            Time after app_main completes before the persistent crash counter
            is cleared. Crashes inside this window accumulate toward the
            safe-mode threshold and trip recovery on the next boot.

    config BOOT_SAFE_MODE_THRESHOLD
        int "Consecutive crashes that trigger safe mode"
        default 5
        range 2 20
        help
            Once the crash counter reaches this value, non-essential
            subsystems (WASM runtime, swarm bridge, mmWave, display, channel
            hopping) are skipped at boot so the OTA endpoint stays
            recoverable.

    config MAIN_LOOP_WDT_TIMEOUT_S
        int "Main-loop task watchdog timeout (seconds)"
        default 30
        range 5 300
        help
            Task watchdog timeout for the application main loop and
            background tasks. The main loop kicks the watchdog every few
            seconds; a real hang triggers an automatic panic + reboot which
            is then captured by the boot crash counter.

    config WIFI_RECONNECT_BACKOFF_MS
        int "WiFi reconnect retry interval after MAX_RETRY (ms)"
        default 30000
        range 1000 600000
        help
            Once the initial 10 fast retries are exhausted the firmware
            keeps trying to reconnect on this slower cadence rather than
            giving up entirely. Required for unattended remote nodes.

endmenu

menu "AMOLED Display (ADR-045)"

    config DISPLAY_ENABLE
        bool "Enable AMOLED display support"
        default y
        help
            Enable RM67162 QSPI AMOLED display and LVGL UI.
            Auto-detects at boot; gracefully skips if no display hardware.
            Requires SPIRAM for frame buffers.

    config DISPLAY_FPS_LIMIT
        int "Display refresh rate limit (FPS)"
        default 30
        range 10 60
        depends on DISPLAY_ENABLE
        help
            Maximum display refresh rate. Lower values save CPU.

    config DISPLAY_BRIGHTNESS
        int "Default backlight brightness (%)"
        default 80
        range 0 100
        depends on DISPLAY_ENABLE

    config DISPLAY_QSPI_CS
        int "QSPI CS GPIO"
        default 6
        depends on DISPLAY_ENABLE

    config DISPLAY_QSPI_CLK
        int "QSPI CLK GPIO"
        default 47
        depends on DISPLAY_ENABLE

    config DISPLAY_QSPI_D0
        int "QSPI D0 GPIO"
        default 18
        depends on DISPLAY_ENABLE

    config DISPLAY_QSPI_D1
        int "QSPI D1 GPIO"
        default 7
        depends on DISPLAY_ENABLE

    config DISPLAY_QSPI_D2
        int "QSPI D2 GPIO"
        default 48
        depends on DISPLAY_ENABLE

    config DISPLAY_QSPI_D3
        int "QSPI D3 GPIO"
        default 5
        depends on DISPLAY_ENABLE

    config DISPLAY_TOUCH_SDA
        int "Touch I2C SDA GPIO"
        default 3
        depends on DISPLAY_ENABLE

    config DISPLAY_TOUCH_SCL
        int "Touch I2C SCL GPIO"
        default 2
        depends on DISPLAY_ENABLE

    config DISPLAY_TOUCH_INT
        int "Touch INT GPIO"
        default 21
        depends on DISPLAY_ENABLE

    config DISPLAY_TOUCH_RST
        int "Touch RST GPIO"
        default 17
        depends on DISPLAY_ENABLE

    config DISPLAY_BL_PIN
        int "Backlight PWM GPIO"
        default 38
        depends on DISPLAY_ENABLE

endmenu

menu "WASM Programmable Sensing (ADR-040)"

    config WASM_ENABLE
        bool "Enable WASM Tier 3 runtime"
        default y
        help
            Enable the WASM3 interpreter for hot-loadable sensing modules.
            Requires WASM3 source in components/wasm3/wasm3-src/.
            Adds ~120 KB flash and ~20 KB SRAM.

    config WASM_MAX_MODULES
        int "Maximum concurrent WASM modules"
        default 4
        range 1 8
        help
            Number of WASM module slots.  Each slot can hold one
            loaded .wasm binary (stored in PSRAM, max 128 KB each).

    config WASM_VERIFY_SIGNATURE
        bool "Require Ed25519 signature verification for WASM uploads"
        default y
        help
            When enabled, uploaded .wasm binaries must include a valid
            Ed25519 signature.  Uses the same signing key as OTA firmware.
            Disable with provision.py --no-wasm-verify for lab/dev use.

    config WASM_TIMER_INTERVAL_MS
        int "WASM on_timer() interval (ms)"
        default 1000
        range 100 60000
        help
            How often to call on_timer() on running WASM modules.
            Default 1000 ms = 1 Hz.

endmenu

menu "Mock CSI (QEMU Testing)"
    config CSI_MOCK_ENABLED
        bool "Enable mock CSI generator (for QEMU testing)"
        default n
        help
            Replace real WiFi CSI with synthetic frame generator.
            Use with QEMU emulation for automated testing.

    config CSI_MOCK_SKIP_WIFI_CONNECT
        bool "Skip WiFi STA connection"
        depends on CSI_MOCK_ENABLED
        default y
        help
            Skip WiFi initialization when using mock CSI.

    config CSI_MOCK_SCENARIO
        int "Mock scenario (0-9, 255=all)"
        depends on CSI_MOCK_ENABLED
        default 255
        range 0 255
        help
            0=empty, 1=static, 2=walking, 3=fall, 4=multi-person,
            5=channel-sweep, 6=mac-filter, 7=ring-overflow,
            8=boundary-rssi, 9=zero-length, 255=run all.

    config CSI_MOCK_SCENARIO_DURATION_MS
        int "Scenario duration (ms)"
        depends on CSI_MOCK_ENABLED
        default 5000
        range 1000 60000

    config CSI_MOCK_LOG_FRAMES
        bool "Log every mock frame (verbose)"
        depends on CSI_MOCK_ENABLED
        default n

    menu "Audio Microphone (ADR-081)"

        config AUDIO_MIC_DEFAULT_SR
            int "Default sample rate (Hz)"
            default 16000
            range 8000 48000
            help
                Initial mic_sample_rate value when NVS has no override.
                16000 fits voice/event detection, technically out of strict
                SPH0645 spec but widely reported to work. Bump to 32000 if
                the part misbehaves.

        config AUDIO_MIC_DEFAULT_SHIFT
            int "Default 32->24 alignment shift (bits)"
            default 8
            range 8 16
            help
                Arithmetic right shift applied to raw 32-bit I2S samples
                to recover the 24-bit sample. SPH0645 left-justifies its
                24-bit data in a 32-bit slot with the bottom 8 bits as
                noise/zero, so shift=8 recovers the full 24-bit signed
                range that maps to -1.0..1.0 after dividing by 2^23.
                Empirically validated on node 4 (2026-05-08); the handoff
                doc's "14" gave correct waveforms but compressed dynamic
                range to 1/64 of the headroom.

        config AUDIO_MIC_HPF_CUTOFF_HZ
            int "DC-removal HPF cutoff (Hz)"
            default 80
            range 20 500
            help
                First-order IIR high-pass filter cutoff applied to remove
                the SPH0645's DC bias. 80 Hz is below voice; raise to ~150
                Hz if low-frequency rumble is a concern.

        config AUDIO_MIC_WINDOW_MS
            int "Feature window (ms)"
            default 1000
            range 100 5000
            help
                Per-window stats are accumulated for this many ms before
                emitting a UDP frame and a serial log line.

        config AUDIO_MIC_RAW_UDP_STREAM
            bool "DEV: stream raw 32-bit samples instead of features"
            default n
            help
                Bandwidth-heavy (~1 Mbps at 16 kHz stereo). Only useful for
                offline DSP work on a host. Leave off in production.
    endmenu

endmenu
```
